/** @file oled.c
 * @brief modules 层 OLED 实现：自有精简 ASCII 字形、静态帧缓存、分页寻址发送。
 */
#include "oled.h"
#include <string.h>

/* 自有 8×16 等宽字体：7×12 有效点阵，上下各留 2 像素，右侧留 1 像素。
 * 按行保存，bit6 为最左像素；字形直接绘制，不对小字形做单向拉伸。
 */
static const uint8_t digits[10][12] = {
    {0x1C,0x22,0x41,0x43,0x45,0x49,0x51,0x61,0x41,0x41,0x22,0x1C}, /* 0 */
    {0x08,0x18,0x28,0x08,0x08,0x08,0x08,0x08,0x08,0x08,0x08,0x3E}, /* 1 */
    {0x3E,0x41,0x41,0x01,0x02,0x04,0x08,0x10,0x20,0x40,0x40,0x7F}, /* 2 */
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    {0x3E,0x41,0x41,0x41,0x41,0x41,0x43,0x3D,0x01,0x01,0x02,0x3C}  /* 9 */
};
static const uint8_t letters[26][12] = {
    {0x08,0x14,0x22,0x41,0x41,0x41,0x7F,0x41,0x41,0x41,0x41,0x41}, /* A */
    {0x7E,0x41,0x41,0x41,0x42,0x7C,0x42,0x41,0x41,0x41,0x41,0x7E}, /* B */
    {0x1E,0x21,0x40,0x40,0x40,0x40,0x40,0x40,0x40,0x40,0x21,0x1E}, /* C */
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    {0x7F,0x01,0x02,0x02,0x04,0x08,0x10,0x20,0x20,0x40,0x40,0x7F}  /* Z */
};

static uint8_t glyph_row(char character, unsigned row) {
    if (character >= '0' && character <= '9') return digits[character - '0'][row];
    if (character >= 'A' && character <= 'Z') return letters[character - 'A'][row];
    switch (character) {
        case '-': return row == 5U ? 0x3EU : 0U;
        case '+': return row == 5U ? 0x3EU : (row >= 3U && row <= 7U ? 0x08U : 0U);
        case '.': return row >= 10U ? 0x0CU : 0U;
        case ':': return row == 3U || row == 4U || row == 8U || row == 9U ? 0x0CU : 0U;
        default: return 0U;
    }
}

void oled_clear(oled_t *oled) {
    memset(oled->pixels, 0, sizeof(oled->pixels));
}

void oled_text_line(oled_t *oled, unsigned line, const char *text) {
    if (line >= 4U || text == NULL) return;
    const unsigned page = line * 2U;
    memset(oled->pixels[page], 0, OLED_WIDTH * 2U);
    for (unsigned character = 0U; character < OLED_TEXT_COLUMNS && text[character] != '\0'; ++character) {
        for (unsigned row = 0U; row < 12U; ++row) {
            const uint8_t glyph = glyph_row(text[character], row);
            const unsigned y = row + 2U;
            for (unsigned column = 0U; column < 7U; ++column) {
                if ((glyph & (1U << (6U - column))) != 0U) {
                    const unsigned x = character * 8U + column;
                    oled->pixels[page + y / 8U][x] |= (uint8_t)(1U << (y % 8U));
                }
            }
        }
    }
}

bool oled_refresh(oled_t *oled) {
    const uint8_t offset = oled->controller == OLED_SH1106 ? 2U : 0U;
    for (unsigned page = 0U; page < OLED_PAGES; ++page) {
        const uint8_t position[] = {(uint8_t)(0xB0U + page), offset, 0x10U};
        if (!oled->bus.write(oled->bus.context, 0x00U, position, sizeof(position))) return false;
        for (unsigned column = 0U; column < OLED_WIDTH; column += 32U) {
            if (!oled->bus.write(oled->bus.context, 0x40U, &oled->pixels[page][column], 32U)) return false;
            if (oled->bus.yield != NULL) oled->bus.yield(oled->bus.context);
        }
    }
    return true;
}

bool oled_initialise(oled_t *oled, const oled_bus_t *bus, oled_controller_t controller) {
    if (oled == NULL || bus == NULL || bus->write == NULL ||
        (controller != OLED_SSD1306 && controller != OLED_SH1106)) return false;
    oled->bus = *bus;
    oled->controller = controller;
    /* 128×64、COM 扫描和段重映射、正常显示；先关屏并清空显存，避免上电随机内容。 */
    const uint8_t common[] = {
        0xAE,0xD5,0x80,0xA8,0x3F,0xD3,0x00,0x40,
        0xA1,0xC8,0xDA,0x12,0x81,0x7F,0xD9,0xF1,0xDB,0x40,0xA4,0xA6
    };
    const uint8_t ssd[] = {0x8D,0x14,0x20,0x02,0x2E}; /* SSD1306 内部电荷泵、页寻址、禁用滚动。 */
    const uint8_t sh[] = {0xAD,0x8B}; /* SH1106 内部 DC-DC。 */
    if (!bus->write(bus->context, 0x00U, common, sizeof(common))) return false;
    const uint8_t *specific = controller == OLED_SSD1306 ? ssd : sh;
    const size_t length = controller == OLED_SSD1306 ? sizeof(ssd) : sizeof(sh);
    if (!bus->write(bus->context, 0x00U, specific, length)) return false;
    oled_clear(oled);
    if (!oled_refresh(oled)) return false;
    const uint8_t display_on = 0xAFU;
    return bus->write(bus->context, 0x00U, &display_on, 1U);
}
